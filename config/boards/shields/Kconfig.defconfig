## config/boards/shields/Kconfig.defconfig
```kconfig
if SHIELD_ERGO68_LEFT

# Name must be less than 16 characters long!
config ZMK_KEYBOARD_NAME
    default "ergo68"

config ZMK_SPLIT_ROLE_CENTRAL
    default y

endif

if SHIELD_ERGO68_LEFT || SHIELD_ERGO68_RIGHT

config ZMK_SPLIT
    default y

endif
```

## config/boards/shields/ergo68/Kconfig.shield
```kconfig
# No whitespace after the comma or in your part name!
config SHIELD_ERGO68_LEFT
    def_bool $(shields_list_contains,ergo68_left)

# No whitespace after the comma or in your part name!
config SHIELD_ERGO68_RIGHT
    def_bool $(shields_list_contains,ergo68_right)
```
